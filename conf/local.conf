## conf/local.conf
```bitbake
remote = {
  host = localhost
  port = 8010
  ssl = false
}

config_refresh_interval = 300sec
status_interval = 100sec

debug = true

run_directory = '/Users/mingqi/uclogs/uc-agent/test_run/'
log_config_file = '/Users/mingqi/uclogs/uc-agent/test_run/log_files.conf'

tail = {
  pos_file = '/Users/mingqi/uclogs/uc-agent/test_run/posdb'
  refresh_interval = 10sec
  save_posotion_interval = 10sec
  max_size = 50MB
  buffer_size = 1MB
}

supervisor = {
  watch_time = 3sec
  restart_wait_time = 1sec
  kill_wait_time = 5sec
}

logging = {
  log_level = debug
  log_file = console
  log_file_size = 50m
  log_file_count = 10
}


buffer = {
  buffer_type = file
  buffer_path = /var/cache/uc-agent/log
  buffer_flush = 3sec
  buffer_size = 1MB
  retry_times = 30
  retry_interval = 1minute
  buffer_queue_size = 200
  concurrency = 1
}

worker_cleanup_timeout : 5sec
```
